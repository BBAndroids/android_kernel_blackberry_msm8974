## drivers/input/misc/bbry/Kconfig
```kconfig
#
# Input misc drivers configuration
#
config STM_LSM303D
	tristate "STM LSM303D acceleration and compass sensor support"
	depends on I2C=y
	default y
	help
	  If you say yes here you get support for STMicroelectronics's
	  acceleration sensors LSM303D.

config STM_L3GD20
	tristate "STM L3GD20 gyro sensor support"
	depends on I2C=y
	default y
	help
	  If you say yes here you get support for STMicroelectronics's
	  gyro sensors L3GD20.

config STMVL6180
	tristate "STM VL6180 Proximity support"
	depends on I2C=y
	default y
	help
	  Say Y here if you want to use STMicroelectronics's proximity sensor
	  through I2C interface.

	  To compile this driver as a module, choose M here: the
	  module will be called stmvl6180.

config SENSOR_HUB
	tristate "Sensor hub passthrough support"
	depends on I2C=y
	default y
	help
	  Say Y here if you want to use the sensor hub i2c passthrough
	  interface

	  To compile this driver as a module, choose M here: the
	  module will be called sensor_hub

config SENSOR_EXTENDED
	tristate "Extended sensor class support"
	default y
	help
	  Say Y here if you want to use the extended sensor class interface

	  To compile this driver as a module, choose M here: the
	  module will be called sensor_extended
```

## drivers/input/touchscreen/synaptics_dsx/Kconfig
```kconfig
#
# Synaptics DSX touchscreen driver configuration
#
config TOUCHSCREEN_SYNAPTICS_DSX
	tristate "Synaptics DSX touchscreen"
	default y
	help
	  Say Y here if you have a Synaptics DSX touchscreen connected
	  to your system.
	  If unsure, say N.

config TOUCHSCREEN_SYNAPTICS_DSX_FW_UPDATE
	tristate "Synaptics DSX touchscreen firmware update module"
	depends on TOUCHSCREEN_SYNAPTICS_DSX
	help
	  Say Y here to enable support for carrying out firmware update.

	  If unsure, say N.

	  To compile this driver as a module, choose M here: the
	  module will be called synaptics_dsx_fw_update.
```
