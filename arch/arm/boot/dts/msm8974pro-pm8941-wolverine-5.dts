/* Copyright (c) 2013-2014, The Linux Foundation. All rights reserved.
 *
 * This program is free software; you can redistribute it and/or modify
 * it under the terms of the GNU General Public License version 2 and
 * only version 2 as published by the Free Software Foundation.
 *
 * This program is distributed in the hope that it will be useful,
 * but WITHOUT ANY WARRANTY; without even the implied warranty of
 * MERCHANTABILITY or FITNESS FOR A PARTICULAR PURPOSE.  See the
 * GNU General Public License for more details.
 */

/dts-v1/;

/include/ "msm8974pro-pm8941.dtsi"
/include/ "msm8974-wolverine.dtsi"

/ {
	model = "MSM 8974 WOLVERINE V5+";
	compatible = "qcom,msm8974-wolverine", "qcom,msm8974";
	qcom,msm-id = <217 0x10000>;
	qcom,board-id = <
		0x84002c0a 0x00005 /* windermere na */
		0x85002c0a 0x00005 /* windermere vzw */
		0x86002c0a 0x00005 /* windermere sprint */
		0x87002c0a 0x00005 /* windermere emea */
		0xf07404b2 0x00005 /* wolverine emea */
		0xf074049a 0x00005 /* wolverine na */
		0xf0740465 0x00005 /* wolverine vzw */
		0xf07404bd 0x00005 /* wolverine sprint */
	>;
};

&cci {
	qcom,camera@0 {
		qcom,mount-angle = <0>;
	};

	qcom,camera@1 {
		qcom,mount-angle = <180>;
	};
};
