qcom,otwl1 {
	qcom,fcc-mah = <3400>;
	qcom,default-rbatt-mohm = <130>;
	qcom,max-voltage-uv = <4350000>;
	qcom,rbatt-capacitive-mohm = <50>;
	qcom,v-cutoff-uv = <3000000>;
	qcom,chg-term-ua = <170000>;
	qcom,batt-id-kohm = <10 14 56>;

	qcom,fcc-temp-lut {
		qcom,lut-col-legend = <(-20) 0 25 40 60>;
		qcom,lut-data = <3344 3364 3365 3362 3352>;
	};

	qcom,pc-temp-ocv-lut {
		qcom,lut-col-legend = <(-20) 0 25 40 60>;
		qcom,lut-row-legend = <100 95 90 85 80>,
				<75 70 65 60 55>,
				<50 45 40 35 30>,
				<25 20 16 13 11>,
				<10 9 8 7 6>,
				<5 4 3 2 1>,
				<0>;
		qcom,lut-data = <4328 4326 4320 4316 4308>,
				<4218 4252 4255 4252 4248>,
				<4146 4194 4199 4196 4192>,
				<4090 4139 4146 4144 4140>,
				<4022 4088 4095 4093 4090>,
				<3960 4040 4047 4046 4042>,
				<3914 3982 4003 4002 3999>,
				<3874 3940 3964 3962 3960>,
				<3842 3898 3918 3920 3918>,
				<3820 3862 3872 3872 3872>,
				<3804 3832 3841 3842 3840>,
				<3790 3809 3818 3818 3818>,
				<3776 3790 3800 3800 3798>,
				<3762 3776 3784 3784 3782>,
				<3746 3764 3769 3766 3758>,
				<3726 3748 3753 3745 3734>,
				<3704 3726 3733 3725 3711>,
				<3682 3708 3707 3700 3686>,
				<3659 3694 3689 3682 3670>,
				<3642 3686 3682 3675 3664>,
				<3632 3682 3681 3674 3662>,
				<3622 3677 3680 3672 3660>,
				<3609 3672 3677 3670 3658>,
				<3592 3663 3673 3666 3654>,
				<3573 3648 3663 3655 3640>,
				<3547 3620 3637 3628 3609>,
				<3514 3576 3594 3584 3562>,
				<3464 3514 3532 3524 3501>,
				<3389 3422 3448 3441 3418>,
				<3260 3282 3324 3316 3290>,
				<3000 3000 3000 3000 3000>;
	};

	qcom,rbatt-sf-lut {
		qcom,lut-col-legend = <(-20) 0 25 40 60>;
		qcom,lut-row-legend = <100 95 90 85 80>,
				<75 70 65 60 55>,
				<50 45 40 35 30>,
				<25 20 16 13 11>,
				<10 9 8 7 6>,
				<5 4 3 2 1>;
		qcom,lut-data = <1499 285 99 81 72>,
				<1499 285 99 81 72>,
				<1444 289 102 82 72>,
				<1413 294 103 82 73>,
				<1351 299 106 83 74>,
				<1293 310 108 85 75>,
				<1279 297 114 88 77>,
				<1266 294 122 93 79>,
				<1265 291 118 95 82>,
				<1278 284 103 84 74>,
				<1302 285 98 82 73>,
				<1345 286 100 82 73>,
				<1397 288 102 83 75>,
				<1461 296 103 85 78>,
				<1536 305 103 82 74>,
				<1623 320 101 79 72>,
				<1731 341 102 81 72>,
				<1837 362 102 81 72>,
				<1930 392 102 80 72>,
				<2005 416 102 82 72>,
				<2062 426 105 83 74>,
				<2025 428 107 85 75>,
				<1940 438 109 86 78>,
				<2143 448 112 88 80>,
				<2407 458 114 89 78>,
				<2683 471 112 86 76>,
				<3031 489 111 85 76>,
				<3598 523 115 88 79>,
				<4585 580 125 96 87>,
				<9017 4162 192 145 125>;
	};
};
