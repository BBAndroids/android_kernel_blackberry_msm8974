qcom,kx50-atl {
	qcom,fcc-mah = <4000>;
	qcom,default-rbatt-mohm = <130>;
	qcom,max-voltage-uv = <4400000>;
	qcom,fg-cc-cv-threshold-uv = <4390000>;
	qcom,fastchg-current-ma = <3600>;
	qcom,rbatt-capacitive-mohm = <50>;
	qcom,batt-id-kohm = <100>;

	qcom,fcc-temp-lut {
		qcom,lut-col-legend = <0 10 25 40 50>;
		qcom,lut-data = <3878 3962 4051 4075 4084>;
	};

	qcom,pc-temp-ocv-lut {
		qcom,lut-col-legend = <0 10 25 40 50>;
		qcom,lut-row-legend = <100 98 96 94 92>,
			<90 88 86 84 82>,
			<80 78 76 74 72>,
			<70 68 66 64 62>,
			<60 58 56 54 52>,
			<50 48 46 44 42>,
			<40 38 36 34 32>,
			<30 28 26 24 22>,
			<20 18 16 14 12>,
			<10 9 8 7 6>,
			<5 4 3 2 1>,
			<0>;
		qcom,lut-data = <4350 4367 4380 4382 4383>,
				<4323 4340 4354 4355 4355>,
				<4297 4314 4328 4330 4330>,
				<4274 4290 4303 4306 4307>,
				<4250 4266 4279 4282 4283>,
				<4227 4243 4255 4258 4260>,
				<4205 4220 4231 4235 4237>,
				<4183 4197 4208 4212 4214>,
				<4161 4174 4185 4189 4190>,
				<4141 4152 4162 4166 4168>,
				<4122 4132 4140 4144 4146>,
				<4104 4113 4119 4122 4124>,
				<4082 4093 4099 4102 4102>,
				<4056 4071 4079 4082 4081>,
				<4033 4048 4058 4061 4061>,
				<4013 4027 4036 4040 4042>,
				<3995 4009 4017 4021 4023>,
				<3980 3992 4000 4004 4006>,
				<3966 3978 3984 3987 3989>,
				<3954 3965 3970 3972 3973>,
				<3941 3951 3956 3957 3958>,
				<3929 3936 3937 3938 3939>,
				<3917 3920 3912 3910 3913>,
				<3905 3900 3891 3887 3890>,
				<3893 3877 3873 3874 3876>,
				<3880 3861 3859 3864 3866>,
				<3867 3851 3850 3855 3856>,
				<3856 3843 3844 3846 3847>,
				<3846 3838 3838 3838 3839>,
				<3838 3833 3832 3831 3830>,
				<3832 3829 3826 3824 3823>,
				<3828 3825 3821 3817 3816>,
				<3824 3821 3816 3811 3809>,
				<3821 3818 3812 3806 3803>,
				<3818 3815 3808 3801 3798>,
				<3815 3811 3803 3796 3792>,
				<3813 3808 3799 3791 3787>,
				<3809 3805 3795 3787 3781>,
				<3804 3799 3790 3781 3775>,
				<3797 3791 3781 3772 3765>,
				<3788 3781 3771 3761 3755>,
				<3776 3770 3761 3751 3744>,
				<3763 3756 3748 3739 3732>,
				<3747 3741 3732 3724 3716>,
				<3733 3726 3718 3710 3702>,
				<3723 3716 3708 3700 3694>,
				<3720 3713 3705 3697 3691>,
				<3718 3712 3703 3695 3689>,
				<3715 3709 3702 3693 3687>,
				<3711 3705 3697 3688 3681>,
				<3691 3684 3675 3663 3653>,
				<3647 3641 3632 3619 3609>,
				<3589 3584 3575 3562 3552>,
				<3511 3505 3497 3484 3473>,
				<3386 3383 3376 3362 3351>,
				<3000 3000 3000 3000 3000>;
	};

	qcom,rbatt-sf-lut {
		qcom,lut-col-legend = <0 10 25 40 50>;
		qcom,lut-row-legend = <100 1>,
			<0>;
		qcom,lut-data = <100 100 100 100 100>,
				<100 100 100 100 100>,
				<100 100 100 100 100>;
	};
};
