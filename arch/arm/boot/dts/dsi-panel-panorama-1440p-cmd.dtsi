// Made by JDI

&mdss_mdp {
	dsi_panorama_1440p_cmd: qcom,mdss_dsi_panorama_1440p_cmd {
		qcom,mdss-dsi-panel-name = "Panorama 1440p cmd mode dsi panel";
		qcom,mdss-dsi-panel-controller = <&mdss_dsi0>;
		qcom,mdss-dsi-panel-type = "dsi_cmd_mode";
		qcom,mdss-dsi-panel-destination = "display_1";
		qcom,mdss-dsi-panel-framerate = <60>;
		qcom,mdss-dsi-panel-clockrate = <900771840>;
		qcom,mdss-dsi-virtual-channel-id = <0>;
		qcom,mdss-dsi-stream = <0>;
		qcom,mdss-dsi-panel-width = <1440>;
		qcom,mdss-dsi-panel-height = <1440>;
		qcom,mdss-pan-physical-width-dimension = <80>;
		qcom,mdss-pan-physical-height-dimension = <80>;
		qcom,mdss-dsi-h-front-porch = <125>;
		qcom,mdss-dsi-h-back-porch = <30>;
		qcom,mdss-dsi-h-pulse-width = <4>;
		qcom,mdss-dsi-h-sync-skew = <0>;
		qcom,mdss-dsi-v-back-porch = <16>;
		qcom,mdss-dsi-v-front-porch = <30>;
		qcom,mdss-dsi-v-pulse-width = <3>;
		qcom,mdss-dsi-h-left-border = <0>;
		qcom,mdss-dsi-h-right-border = <0>;
		qcom,mdss-dsi-v-top-border = <0>;
		qcom,mdss-dsi-v-bottom-border = <0>;
		qcom,mdss-dsi-bpp = <24>;
		qcom,mdss-dsi-underflow-color = <0xff>;
		qcom,mdss-dsi-border-color = <0>;
		qcom,mdss-dsi-on-command = [
			15 01 00 00 0a 00 02 53 2c /* set control display */
			39 01 00 00 0a 00 05 2a 00 00 05 9f  /* set column address: 0 - 1440 */
			39 01 00 00 0a 00 05 2b 00 00 05 9f  /* set page address: 0 - 1440 */
			15 01 00 00 0a 00 02 36 00 /* set address mode */
			15 01 00 00 0a 00 02 3a 77 /* set pixel format */
			15 01 00 00 0a 00 02 51 ff /* set display brightness */
			15 01 00 00 0a 00 02 55 00 /* set power save */
			15 01 00 00 0a 00 02 5e 00 /* set CABC min brightness */
			05 01 00 00 78 00 02 11 00 /* exit sleep mode */

			// usleep 125000

			05 01 00 00 0a 00 02 29 00 /* set display on */
		];
		qcom,mdss-dsi-off-command = [
			 05 01 00 00 78 00 01 28 /* set display off */
			 05 01 00 00 78 00 01 10 /* enter sleep mode */
		];
		qcom,mdss-dsi-on-command-state = "dsi_lp_mode";
		qcom,mdss-dsi-off-command-state = "dsi_hs_mode";
		qcom,mdss-dsi-h-sync-pulse = <0>;
		qcom,mdss-dsi-traffic-mode = "non_burst_sync_event";
		qcom,mdss-dsi-lane-0-state;
		qcom,mdss-dsi-lane-1-state;
		qcom,mdss-dsi-lane-2-state;
		qcom,mdss-dsi-lane-3-state;
		qcom,mdss-dsi-te-pin-select = <1>;
		qcom,mdss-dsi-te-using-te-pin;
		qcom,mdss-dsi-wr-mem-start = <0x2c>;
		qcom,mdss-dsi-wr-mem-continue = <0x3c>;
		qcom,mdss-dsi-te-dcs-command = <1>;
		qcom,mdss-dsi-te-check-enable;
		qcom,mdss-dsi-panel-timings = [e7 39 27 00 6a 6d 2c 3c 2d 03 04 a0];
		qcom,mdss-dsi-t-clk-post = <0x23>;
		qcom,mdss-dsi-t-clk-pre = <0x2a>;
		qcom,mdss-dsi-bl-min-level = <1>;
		qcom,mdss-dsi-bl-max-level = <4095>;
		qcom,mdss-dsi-bl-pmic-pwm-frequency = <100>;
		qcom,mdss-dsi-bl-pmic-bank-select = <7>;
		qcom,mdss-dsi-dma-trigger = "trigger_sw";
		qcom,mdss-dsi-mdp-trigger = "none";
		qcom,mdss-dsi-bl-pmic-control-type = "bl_ctrl_wled";
		qcom,mdss-dsi-reset-sequence = <1 60>, <0 200>, <1 60>;
		qcom,partial-update-enabled;
		cm,mdss-livedisplay-cabc-cmd = [15 01 00 00 10 00 02 55 00];
		cm,mdss-livedisplay-cabc-ui-value = <0x01>;
		cm,mdss-livedisplay-cabc-image-value = <0x02>;
		cm,mdss-livedisplay-cabc-video-value = <0x03>;
		cm,mdss-livedisplay-sre-weak-value = <0x50>;
		cm,mdss-livedisplay-sre-medium-value = <0x60>;
		cm,mdss-livedisplay-sre-strong-value = <0x70>;
		cm,mdss-livedisplay-aco-value = <0x80>;
		cm,mdss-livedisplay-post-cmd = [05 01 00 00 10 00 01 29];
	};
};
